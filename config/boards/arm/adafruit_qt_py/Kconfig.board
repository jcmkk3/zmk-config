## config/boards/arm/adafruit_qt_py/Kconfig.board
```kconfig
# Adafruit Qt PY board configuration

# Copyright (c) 2020 Google LLC.
# SPDX-License-Identifier: Apache-2.0

config BOARD_ADAFRUIT_QT_PY
	bool "Adafruit Qt PY"
	depends on SOC_PART_NUMBER_SAMD21E18A
```

## config/boards/arm/adafruit_qt_py/adafruit_qt_py_defconfig
```kconfig
# SPDX-License-Identifier: Apache-2.0

CONFIG_SOC_SERIES_SAMD21=y
CONFIG_SOC_PART_NUMBER_SAMD21E18A=y
CONFIG_BOARD_ADAFRUIT_QT_PY=y
CONFIG_CORTEX_M_SYSTICK=y
CONFIG_CONSOLE=n
CONFIG_UART_CONSOLE=y
CONFIG_UART_INTERRUPT_DRIVEN=y
CONFIG_SERIAL=n
CONFIG_PINMUX=y
CONFIG_BOOTLOADER_BOSSA=y
CONFIG_BOOTLOADER_BOSSA_ADAFRUIT_UF2=y
CONFIG_BUILD_OUTPUT_UF2=y
```

## config/boards/arm/raytac_mdbt50q_rx/Kconfig.board
```kconfig
config BOARD_RAYTAC_MDBT50Q_RX
	bool "Raytac MDBT50Q-RX"
	depends on SOC_NRF52840_QIAA
```

## config/boards/arm/raytac_mdbt50q_rx/raytac_mdbt50q_rx_defconfig
```kconfig
CONFIG_SOC_SERIES_NRF52X=y
CONFIG_SOC_NRF52840_QIAA=y
CONFIG_BOARD_RAYTAC_MDBT50Q_RX=y

# Follow DeviceTree partition.
CONFIG_USE_DT_CODE_PARTITION=y

# Build UF2 firmware.
CONFIG_BUILD_OUTPUT_UF2=y

# Enable MPU.
CONFIG_ARM_MPU=y

# Enable hardware stack protection.
CONFIG_HW_STACK_PROTECTION=y

# Enable basic functionality.
CONFIG_ADC=y
CONFIG_GPIO=y

# Use NVS for settings.
CONFIG_MPU_ALLOW_FLASH_WRITE=y
CONFIG_NVS=y
CONFIG_SETTINGS_NVS=y
CONFIG_FLASH=y
CONFIG_FLASH_PAGE_LAYOUT=y
CONFIG_FLASH_MAP=y

# Set NVS sector count to reflect storage partition size.
CONFIG_SETTINGS_NVS_SECTOR_COUNT=7

# Use maximum Bluetooth transmit power.
CONFIG_BT_CTLR_TX_PWR_PLUS_8=y

# Include support for Coded PHY.
CONFIG_BT_CTLR_PHY_CODED=y
```

## config/boards/shields/alphalphaplus/Kconfig.defconfig
```kconfig
if SHIELD_ALPHALPHAPLUS

config ZMK_KEYBOARD_NAME
    default "Alphalpha+"

endif
```

## config/boards/shields/arm/raytac_mdbt50q_rx/Kconfig.defconfig
```kconfig
if BOARD_RAYTAC_MDBT50Q_RX

config BOARD
	default "Raytac MDBT50Q-RX"

if USB

config USB_NRFX
	default y

config USB_DEVICE_STACK
	default y

endif # USB

config BT_CTLR
	default BT

endif # BOARD_RAYTAC_MDBT50Q_RX
```

## config/boards/shields/berylline/Kconfig.defconfig
```kconfig
# Copyright (c) 2020 The ZMK Contributors
# SPDX-License-Identifier: MIT

if SHIELD_BERYLLINE_LEFT

config ZMK_KEYBOARD_NAME
	default "Berylline"

config ZMK_SPLIT_BLE_ROLE_CENTRAL
	default y

endif

if SHIELD_BERYLLINE_LEFT || SHIELD_BERYLLINE_RIGHT

config ZMK_SPLIT
	default y

endif
```

## config/boards/shields/berylline/Kconfig.shield
```kconfig
# Copyright (c) 2020 The ZMK Contributors
# SPDX-License-Identifier: MIT

config SHIELD_BERYLLINE_DONGLE
	def_bool $(shields_list_contains,berylline_dongle)

config SHIELD_BERYLLINE_LEFT
	def_bool $(shields_list_contains,berylline_left)

config SHIELD_BERYLLINE_RIGHT
	def_bool $(shields_list_contains,berylline_right)
```

## config/boards/shields/berylline03/Kconfig.defconfig
```kconfig
# Copyright (c) 2020 The ZMK Contributors
# SPDX-License-Identifier: MIT

if SHIELD_BERYLLINE03_DONGLE

config ZMK_KEYBOARD_NAME
	default "Berylline v0.3"

config ZMK_SPLIT_BLE_ROLE_CENTRAL
	default y

endif

if SHIELD_BERYLLINE03_DONGLE || SHIELD_BERYLLINE03_LEFT || SHIELD_BERYLLINE03_RIGHT

config ZMK_SPLIT
	default y

endif
```

## config/boards/shields/berylline03/Kconfig.shield
```kconfig
# Copyright (c) 2020 The ZMK Contributors
# SPDX-License-Identifier: MIT

config SHIELD_BERYLLINE03_DONGLE
	def_bool $(shields_list_contains,berylline_dongle)

config SHIELD_BERYLLINE03_LEFT
	def_bool $(shields_list_contains,berylline03_left)

config SHIELD_BERYLLINE03_RIGHT
	def_bool $(shields_list_contains,berylline03_right)
```

## config/boards/shields/calliope/Kconfig.defconfig
```kconfig
# Copyright (c) 2022 The ZMK Contributors
# SPDX-License-Identifier: MIT

if SHIELD_CALLIOPE_LEFT

config ZMK_KEYBOARD_NAME
	default "Calliope"

choice ZMK_SPLIT_SERIAL_ROLE
	default ZMK_SPLIT_SERIAL_ROLE_CENTRAL
endchoice

endif

if SHIELD_SWOOP_RIGHT

choice ZMK_SPLIT_SERIAL_ROLE
	default ZMK_SPLIT_SERIAL_ROLE_PERIPHERAL
endchoice

endif

if SHIELD_CALLIOPE_LEFT || SHIELD_CALLIOPE_RIGHT

config ZMK_SPLIT
	default y

endif
```

## config/boards/shields/calliope/Kconfig.shield
```kconfig
# Copyright (c) 2020 The ZMK Contributors
# SPDX-License-Identifier: MIT

config SHIELD_CALLIOPE_LEFT
	def_bool $(shields_list_contains,calliope_left)

config SHIELD_CALLIOPE_RIGHT
	def_bool $(shields_list_contains,calliope_right)
```

## config/boards/shields/calliope/boards/adafruit_qt_py/Kconfig.defconfig
```kconfig
# Adafruit Qt PY board configuration

# Copyright (c) 2020 Google LLC.
# SPDX-License-Identifier: Apache-2.0

config BOARD
	default "adafruit_qt_py"
	depends on BOARD_ADAFRUIT_QT_PY
```

## config/boards/shields/calliope/boards/seeeduino_xiao.conf
```kconfig
CONFIG_CONSOLE=n
CONFIG_SERIAL=y
CONFIG_UART_CONSOLE=n
CONFIG_UART_INTERRUPT_DRIVEN=n
CONFIG_ZMK_USB=y
```

## config/boards/shields/hummingbird/Kconfig.defconfig
```kconfig
# Copyright (c) 2020 The ZMK Contributors
# SPDX-License-Identifier: MIT

if SHIELD_HUMMINGBIRD

config ZMK_KEYBOARD_NAME
    default "Hummingbird"

config ZMK_USB
    default y

endif
```

## config/boards/shields/hummingbird/boards/seeeduino_xiao.conf
```kconfig
CONFIG_CONSOLE=n
CONFIG_UART_CONSOLE=n
CONFIG_UART_INTERRUPT_DRIVEN=n
CONFIG_SERIAL=n
```

## config/boards/shields/ut22/Kconfig.defconfig
```kconfig
# SPDX-License-Identifier: MIT

if SHIELD_UT22

config ZMK_KEYBOARD_NAME
    default "ut22"

endif
```

## config/west.yml
```yaml
manifest:
  remotes:
    - name: zmkfirmware
      url-base: https://github.com/zmkfirmware
    - name: jcmkk3
      url-base: https://github.com/jcmkk3
  projects:
    - name: zmk
      remote: zmkfirmware
      revision: v0.3
      import: app/west.yml
    - name: zmk-keyboard-berylline
      remote: jcmkk3
      revision: main
  self:
    path: config
```

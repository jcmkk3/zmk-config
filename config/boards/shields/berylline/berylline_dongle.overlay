/*
 * Copyright (c) 2023 The ZMK Contributors
 *
 * SPDX-License-Identifier: MIT
 */

#include <dt-bindings/zmk/kscan_mock.h>
#include "berylline.dtsi"

&kscan_faceup {
    compatible = "zmk,kscan-mock";
    events = <>;
};

&kscan_facedown {
    compatible = "zmk,kscan-mock";
    events = <>;
};

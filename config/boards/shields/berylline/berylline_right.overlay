/*
 * Copyright (c) 2020 The ZMK Contributors
 *
 * SPDX-License-Identifier: MIT
 */

#include "berylline.dtsi"

&default_transform {
	col-offset = <15>;
};

&kscan_faceup {
	input-gpios
	= <&pro_micro 19 (GPIO_ACTIVE_LOW | GPIO_PULL_UP)>
	, <&pro_micro 14 (GPIO_ACTIVE_LOW | GPIO_PULL_UP)>
	, <&pro_micro 4 (GPIO_ACTIVE_LOW | GPIO_PULL_UP)>
	, <&pro_micro 7  (GPIO_ACTIVE_LOW | GPIO_PULL_UP)>
	, <&pro_micro 3  (GPIO_ACTIVE_LOW | GPIO_PULL_UP)>
	, <&pro_micro 18 (GPIO_ACTIVE_LOW | GPIO_PULL_UP)>
	, <&pro_micro 16 (GPIO_ACTIVE_LOW | GPIO_PULL_UP)>
	, <&pro_micro 5 (GPIO_ACTIVE_LOW | GPIO_PULL_UP)>
	, <&pro_micro 8  (GPIO_ACTIVE_LOW | GPIO_PULL_UP)>
	, <&pro_micro 2  (GPIO_ACTIVE_LOW | GPIO_PULL_UP)>
	, <&pro_micro 10 (GPIO_ACTIVE_LOW | GPIO_PULL_UP)>
	, <&pro_micro 6 (GPIO_ACTIVE_LOW | GPIO_PULL_UP)>
	, <&pro_micro 9  (GPIO_ACTIVE_LOW | GPIO_PULL_UP)>
	, <&pro_micro 20  (GPIO_ACTIVE_LOW | GPIO_PULL_UP)>
	, <&pro_micro 15  (GPIO_ACTIVE_LOW | GPIO_PULL_UP)>
	;
};

&kscan_facedown {
	input-gpios
	= <&pro_micro 4  (GPIO_ACTIVE_LOW | GPIO_PULL_UP)>
	, <&pro_micro 7  (GPIO_ACTIVE_LOW | GPIO_PULL_UP)>
	, <&pro_micro 19 (GPIO_ACTIVE_LOW | GPIO_PULL_UP)>
	, <&pro_micro 14 (GPIO_ACTIVE_LOW | GPIO_PULL_UP)>
	, <&pro_micro 20 (GPIO_ACTIVE_LOW | GPIO_PULL_UP)>
	, <&pro_micro 5  (GPIO_ACTIVE_LOW | GPIO_PULL_UP)>
	, <&pro_micro 8  (GPIO_ACTIVE_LOW | GPIO_PULL_UP)>
	, <&pro_micro 18 (GPIO_ACTIVE_LOW | GPIO_PULL_UP)>
	, <&pro_micro 16 (GPIO_ACTIVE_LOW | GPIO_PULL_UP)>
	, <&pro_micro 21 (GPIO_ACTIVE_LOW | GPIO_PULL_UP)>
	, <&pro_micro 9  (GPIO_ACTIVE_LOW | GPIO_PULL_UP)>
	, <&pro_micro 15 (GPIO_ACTIVE_LOW | GPIO_PULL_UP)>
	, <&pro_micro 10 (GPIO_ACTIVE_LOW | GPIO_PULL_UP)>
	, <&pro_micro 3  (GPIO_ACTIVE_LOW | GPIO_PULL_UP)>
	, <&pro_micro 6  (GPIO_ACTIVE_LOW | GPIO_PULL_UP)>
	;
};
